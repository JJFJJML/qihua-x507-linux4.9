/*
 * lvds 800x600 support.
 */

&soc {
	disp: disp@01000000 {	
		fb0_width           = <800>;
		fb0_height          = <600>;
	};

	lcd0: lcd0@01c0c000 {
		lcd_used            = <1>;

		lcd_driver_name     = "default_lcd";
		lcd_backlight       = <250>;
		lcd_if              = <3>;

		lcd_x               = <800>;
		lcd_y               = <600>;
		lcd_width           = <162>;
		lcd_height          = <121>;
		lcd_dclk_freq       = <80>;

		lcd_pwm_used        = <1>;
		lcd_pwm_ch          = <0>;
		lcd_pwm_freq        = <50000>;
		lcd_pwm_pol         = <0>;
		lcd_pwm_max_limit   = <255>;
	

		lcd_hbp             = <100>;
		lcd_ht              = <1286>;
		lcd_hspw            = <20>;
		lcd_vbp             = <5>;
		lcd_vt              = <728>;
		lcd_vspw            = <8>;
		
		lcd_lvds_if         = <0>;
		lcd_lvds_colordepth = <1>;
		lcd_lvds_mode       = <0>;
		lcd_frm             = <0>;
		lcd_hv_clk_phase    = <0>;
		lcd_hv_sync_polarity= <0>;
		lcd_gamma_en        = <0>;
		lcd_bright_curve_en = <0>;
		lcd_cmap_en         = <0>;
		lcd_fsync_en        = <0>;
		lcd_fsync_act_time  = <1000>;
		lcd_fsync_dis_time  = <1000>;
		lcd_fsync_pol       = <0>;

		deu_mode            = <0>;
		lcdgamma4iep        = <22>;
		smart_color         = <90>;

		lcd_pin_power = "bldo1";
	
		lcd_power = "dc1sw";
		lcd_bl_en        = <&pio PA 12 1 0 3 1>;
		pinctrl-0 = <&lvds0_pins_a>;
		pinctrl-1 = <&lvds0_pins_b>;

	};
};
